## drivers/sensor/ti/opt3001/Kconfig
```kconfig
# OPT3001 light sensor configuration options

# Copyright (c) 2019 Actinius
# SPDX-License-Identifier: Apache-2.0

config OPT3001
	bool "OPT3001 Light Sensor"
	default y
	depends on DT_HAS_TI_OPT3001_ENABLED
	select I2C
	help
	  Enable driver for OPT3001 light sensors.

config OPT3001_EMUL
	bool "OPT3001 emulator"
	depends on I2C_EMUL
	default y if ZTEST
	help
	  Enable I2C emulator for OPT3001 (used in native_sim tests).

if OPT3001

module = OPT3001
thread_priority = 10
thread_stack_size = 1024
source "drivers/sensor/Kconfig.trigger_template"

endif # OPT3001
```

## tests/drivers/sensor/opt3001/testcase.yaml
```yaml
# Copyright (c) 2024 Adrien Leravat
# SPDX-License-Identifier: Apache-2.0

tests:
  drivers.sensor.opt3001:
    tags:
      - drivers
      - sensor
      - subsys
    platform_allow:
      - native_sim
```
